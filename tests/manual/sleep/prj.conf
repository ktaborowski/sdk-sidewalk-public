## CMakeLists.txt
```
#
# Copyright (c) 2023 Nordic Semiconductor ASA
#
# SPDX-License-Identifier: LicenseRef-Nordic-5-Clause
#

cmake_minimum_required(VERSION 3.20.0)

find_package(Zephyr REQUIRED HINTS $ENV{ZEPHYR_BASE})
project(sleep)

target_sources(app PRIVATE
  src/main.c
)
```

## sample.yaml
```
sample:
  name: sleep current measurement app
  description: Simple app to measure idle current consumption on nRF54L
tests:
  sidewalk.test.sleep:
    sysbuild: true
    build_only: true
    platform_allow: nrf52840dk/nrf52840 nrf54l15pdk/nrf54l15/cpuapp
    integration_platforms:
      - nrf52840dk/nrf52840
      - nrf54l15pdk/nrf54l15/cpuapp
    tags: Sidewalk
```

## prj.conf
```kconfig
#
# Copyright (c) 2022 Nordic Semiconductor ASA
#
# SPDX-License-Identifier: LicenseRef-Nordic-5-Clause
#

# CONFIG_LOG=y

# Security
# CONFIG_NRF_SECURITY=y
# CONFIG_PSA_CRYPTO_DRIVER_CRACEN=y

# Disable gpio
CONFIG_DK_LIBRARY=n
CONFIG_GPIO=n

# Use LFXO
CONFIG_CLOCK_CONTROL_NRF_K32SRC_XTAL=y
CONFIG_SOC_NRF_FORCE_CONSTLAT=n
CONFIG_CLOCK_CONTROL_NRF_K32SRC_SYNTH=n
CONFIG_POWEROFF=y #this makes grtc driver not force syscounter on all the time, remove when https://github.com/nrfconnect/sdk-nrf-next/pull/2132 is merged

# Disable logs
CONFIG_NCS_BOOT_BANNER=n
CONFIG_CONSOLE=n
CONFIG_SERIAL=n
CONFIG_UART_CONSOLE=n
CONFIG_USE_SEGGER_RTT=n
CONFIG_LOG=n
CONFIG_CONSOLE_HANDLER=n
CONFIG_BOOT_BANNER=n
CONFIG_PRINTK=n
CONFIG_PRINTK_SYNC=n
```

## src/main.c
```c
/*
 * Copyright (c) 2024 Nordic Semiconductor ASA
 *
 * SPDX-License-Identifier: LicenseRef-Nordic-5-Clause
 */

#include <zephyr/kernel.h>
// #include <zephyr/logging/log.h>
// LOG_MODULE_REGISTER(main, LOG_LEVEL_DBG);

int main(void)
{
	// LOG_INF("Hello world!");

	for(;;){
		k_sleep(K_MSEC(500));
	}

	return 0;
}
```
