## samples/sid_end_device/sysbuild/mcuboot/boards/nrf52840dk_nrf52840.conf
```kconfig
#
# Copyright (c) 2023 Nordic Semiconductor ASA
#
# SPDX-License-Identifier: LicenseRef-Nordic-5-Clause
#

# Ensure that the qspi driver is disabled by default
CONFIG_SPI=n
CONFIG_SPI_NOR=n
CONFIG_NORDIC_QSPI_NOR=n

# Disable the Flash Patch and Breakpoint (FPB) feature
# to increase the security of the device.
CONFIG_DISABLE_FLASH_PATCH=y
CONFIG_REBOOT=y
```

## tests/functional/spi_bus/boards/rak4631_nrf52840.conf
```kconfig
#
# Copyright (c) 2024 Nordic Semiconductor ASA
#
# SPDX-License-Identifier: LicenseRef-Nordic-5-Clause
#

CONFIG_SIDEWALK_DFU=n

# RTT console
CONFIG_SERIAL=n
CONFIG_UART_CONSOLE=n
CONFIG_RTT_CONSOLE=y
CONFIG_USE_SEGGER_RTT=y
CONFIG_LOG_BACKEND_RTT=y
CONFIG_LOG_BACKEND_RTT_BUFFER=1
CONFIG_LOG_BACKEND_RTT_BUFFER_SIZE=8096
CONFIG_SHELL=y
CONFIG_SHELL_BACKEND_RTT=y
CONFIG_REBOOT=y
```

## tests/manual/simple_bootloader/Kconfig.sysbuild
```kconfig
#
# Copyright (c) 2023 Nordic Semiconductor ASA
#
# SPDX-License-Identifier: LicenseRef-Nordic-5-Clause
#

config NRF_DEFAULT_EMPTY
	default y if BOARD_NRF5340DK_NRF5340_CPUAPP

choice BOOTLOADER
	default BOOTLOADER_MCUBOOT
endchoice

source "${ZEPHYR_BASE}/share/sysbuild/Kconfig"
```

## tests/unit_tests/pal_sw_interrupts/testcase.yaml
```yaml
tests:
  unity.sidewalk.unit_tests.interrupts:
    sysbuild: true
    tags: Sidewalk
    type: unit
```

## tests/unit_tests/sid_dut_shell/testcase.yaml
```yaml
tests:
  sidewalk.unit_tests.sid_dut_shell:
    sysbuild: true
    tags: Sidewalk
    type: unit
```

## tests/unit_tests/state_notifier/testcase.yaml
```yaml
tests:
  sidewalk.unit_tests.state_notifier:
    sysbuild: true
    tags: Sidewalk
    type: unit
```
